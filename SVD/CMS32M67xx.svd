# CMS32M67xx register map
Vendor: CMS; Series: CMS32M67xx; File version: 1.2
CPU: CM0+ r0p1, little endian, no MPU, no FPU, VTOR, 2 interrupt priority bits
Registers are 32-bit, read-write, reset 0x0 unless marked. A register's access mark holds for its fields unless they carry their own. Offsets are from the block's base; [hi:lo] are bit positions; {n}, {i} and the like mark numbered series; 'fields as' and 'values as' point back to an identical list.

## PORT — Port functions
Base 0x40040000
0x00 P0 8-bit — Port register 0
0x01 P1 8-bit — Port register 1
{0x0+i} P{i} 8-bit (reset mask 0x7F) (i=2..5) — Port register {i}
0x20 PM0 8-bit reset 0xFF — Port mode register 0
0x21 PM1 8-bit reset 0xFF (reset mask 0x7F) — Port mode register 1
{0x20+i} PM{i} 8-bit reset 0xFF (i=2..5) — Port mode register {i}
0x30 PU0 8-bit — Pull-up resistor option register 0
0x31 PU1 8-bit reset 0x1 — Pull-up resistor option register 1
{0x30+i} PU{i} 8-bit reset 0x40 (reset mask 0x7F) (i=2..5) — Pull-up resistor option register {i}
0x40 PD0 8-bit — Pull-down resistor option register 0
0x41 PD1 8-bit — Pull-down resistor option register 1
{0x40+i} PD{i} 8-bit (reset mask 0x7F) (i=2..5) — Pull-down resistor option register {i}
0x50 POM0 8-bit — Port output mode register 0
0x51 POM1 8-bit — Port output mode register 1
{0x50+i} POM{i} 8-bit (reset mask 0x7F) (i=2..5) — Port output mode register {i}
0x60 PMC0 8-bit reset 0xFF — Port mode control register 0
0x61 PMC1 8-bit reset 0xFF — Port mode control register 1
{0x60+i} PMC{i} 8-bit reset 0xFF (reset mask 0x7F) (i=2..5) — Port mode control register {i}
{0x70+i} PSET{i} 8-bit (i=0..5) — Port set register {i}
{0x80+i} PCLR{i} 8-bit (i=0..5) — Port clear register {i}
{0x800+2i} P{i:02}CFG 8-bit (i=0..7) — Alterate Output Function configuration register
  [2:0] CFG
    0=GPIO (Port used as GPIO); {v}=FUNC{v} (Port used as Function{v}) (v=1..7)
{0x7FC+2i} P{i}CFG 8-bit (i=10..17) — Alterate Output Function configuration register
  fields as P00CFG
{0x7F8+2i} P{i}CFG 8-bit (i=20..25) — Alterate Output Function configuration register
  fields as P00CFG
{0x7F4+2i} P{i}CFG 8-bit (i=30..37) — Alterate Output Function configuration register
  fields as P00CFG
{0x7F0+2i} P{i}CFG 8-bit (i=40..47) — Alterate Output Function configuration register
  fields as P00CFG
{0x7EC+2i} P{i}CFG 8-bit (i=50..57) — Alterate Output Function configuration register
  fields as P00CFG
{0x860+i} INT{i}CFG 8-bit (reset mask 0x3F) (i=0..3) — INT{i} alternate function pin configuration register
  [6:0] CFG
    {v}=P{v:02} (P{v:02} used as INT{i}) (v=0..7); {v}=P{v-6} (P{v-6} used as INT{i}) (v=16..23); {v}=P{v-12} (P{v-12} used as INT{i}) (v=32..37); {v}=P{v-18} (P{v-18} used as INT{i}) (v=48..55); 64=P40 (P40 used as INT{i}); 65=P41 (P31 used as INT{i}); {v}=P{v-24} (P{v-24} used as INT{i}) (v=66..71); {v}=P{v-30} (P{v-30} used as INT{i}) (v=80..87)
0x864 TI00CFG 8-bit (reset mask 0x3F) — TI00 alternate function pin configuration register
  [6:0] CFG
    {v}=P{v:02} (P{v:02} used as TI00) (v=0..7); {v}=P{v-6} (P{v-6} used as TI00) (v=16..23); {v}=P{v-12} (P{v-12} used as TI00) (v=32..37); {v}=P{v-18} (P{v-18} used as TI00) (v=48..55); 64=P40 (P40 used as TI00); 65=P41 (P31 used as TI00); {v}=P{v-24} (P{v-24} used as TI00) (v=66..71); {v}=P{v-30} (P{v-30} used as TI00) (v=80..87)
0x865 TI01CFG 8-bit (reset mask 0x3F) — TI01 alternate function pin configuration register
  [6:0] CFG
    {v}=P{v:02} (P{v:02} used as TI01) (v=0..7); {v}=P{v-6} (P{v-6} used as TI01) (v=16..23); {v}=P{v-12} (P{v-12} used as TI01) (v=32..37); {v}=P{v-18} (P{v-18} used as TI01) (v=48..55); 64=P40 (P40 used as TI01); 65=P41 (P31 used as TI01); {v}=P{v-24} (P{v-24} used as TI01) (v=66..71); {v}=P{v-30} (P{v-30} used as TI01) (v=80..87)
0x866 TI02CFG 8-bit (reset mask 0x3F) — TI02 alternate function pin configuration register
  [6:0] CFG
    {v}=P{v:02} (P{v:02} used as TI02) (v=0..7); {v}=P{v-6} (P{v-6} used as TI02) (v=16..23); {v}=P{v-12} (P{v-12} used as TI02) (v=32..37); {v}=P{v-18} (P{v-18} used as TI02) (v=48..52); 53=P35 (P35 used as TI03); 54=P36 (P36 used as TI02); 55=P37 (P37 used as TI02); 64=P40 (P40 used as TI02); 65=P41 (P31 used as TI02); {v}=P{v-24} (P{v-24} used as TI02) (v=66..71); {v}=P{v-30} (P{v-30} used as TI02) (v=80..87)
0x867 TI03CFG 8-bit (reset mask 0x3F) — TI03 alternate function pin configuration register
  [6:0] CFG
    {v}=P{v:02} (P{v:02} used as TI03) (v=0..7); {v}=P{v-6} (P{v-6} used as TI03) (v=16..23); {v}=P{v-12} (P{v-12} used as TI03) (v=32..37); {v}=P{v-18} (P{v-18} used as TI03) (v=48..55); 64=P40 (P40 used as TI03); 65=P41 (P31 used as TI03); {v}=P{v-24} (P{v-24} used as TI03) (v=66..71); {v}=P{v-30} (P{v-30} used as TI03) (v=80..87)
0x868 UART0RXDCFG 8-bit — UARTRXD alternate function pin configuration register
  [2:0] CFG
    0=P00 (P00 used as UARTRXD); 1=P01 (P01 used as UARTRXD); 2=P15 (P15 used as UARTRXD); 3=P16 (P16 used as UARTRXD); 4=P34 (P34 used as UARTRXD); 5=P35 (P35 used as UARTRXD)
0x869 EPWMBKINCFG 8-bit — EPWMBKIN alternate function pin configuration register
  [2:0] CFG
    0=P13 (P13 used as EPWMBKIN); 1=P16 (P16 used as EPWMBKIN); 2=P23 (P23 used as EPWMBKIN); 3=P55 (P55 used as EPWMBKIN)
0x86A CCP0AINCFG 8-bit — CCP0AIN alternate function pin configuration register
  [2:0] CFG
    0=P00 (P00 used as CCP0AIN); 1=P06 (P06 used as CCP0AIN); 2=P24 (P24 used as CCP0AIN)
0x86B CCP0BINCFG 8-bit — CCP0BIN alternate function pin configuration register
  [2:0] CFG
    0=P01 (P01 used as CCP0BIN); 1=P07 (P07 used as CCP0BIN); 2=P23 (P23 used as CCP0BIN); 3=P52 (P52 used as CCP0BIN)
0x86C CCP1AINCFG 8-bit — CCP1AIN alternate function pin configuration register
  [2:0] CFG
    0=P02 (P02 used as CCP1AIN); 1=P04 (P04 used as CCP1AIN); 2=P11 (P11 used as CCP1AIN); 3=P25 (P25 used as CCP1AIN); 4=P56 (P56 used as CCP1AIN)
0x86D CCP1BINCFG 8-bit — CCP1BIN alternate function pin configuration register
  [2:0] CFG
    0=P03 (P03 used as CCP1BIN); 1=P05 (P05 used as CCP1BIN); 2=P12 (P12 used as CCP1BIN); 3=P53 (P53 used as CCP1BIN); 4=P57 (P57 used as CCP1BIN)
0x86E UART1RXDCFG 8-bit — UART1RXD alternate function pin configuration register
  [2:0] CFG
    0=P23 (P23 used as UARTRXD); 1=P24 (P24 used as UARTRXD); 2=P25 (P25 used as UARTRXD); 3=P53 (P53 used as UARTRXD); 4=P54 (P54 used as UARTRXD); 5=P55 (P55 used as UARTRXD)
{0x86F+i} HALL{i}CFG 8-bit (i=0..2) — HALL{i} input select register
0x874 P0TTLCFG 8-bit — Port 0 TTL input select register
0x87B PMS 8-bit (reset mask 0x1) — Port mode select register
