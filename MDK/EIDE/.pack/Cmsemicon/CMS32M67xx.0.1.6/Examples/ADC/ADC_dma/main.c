/***********************************************************************************************************************
* Copyright (C) . All rights reserved.
***********************************************************************************************************************/

/***********************************************************************************************************************
* File Name    : main.c
* Version      :  
* Device(s)    : BAT32M6510
* Tool-Chain   : MDK(armcc)
* Description  : This file is a template.
* Creation Date: 2022/8/24
***********************************************************************************************************************/

/***********************************************************************************************************************
Macro Definitions
***********************************************************************************************************************/

/***********************************************************************************************************************
Includes
***********************************************************************************************************************/
#include <stdio.h>
#include "demo_uart.h"
#include "demo_adc.h"
#include "demo_dma.h"
/***********************************************************************************************************************
Global variables and functions
***********************************************************************************************************************/
#define ADC_MAX_RECV_LEN		100	
#define DMA_EN0      *((volatile unsigned short *)(0x40005000))
volatile uint32_t g_ticks;
volatile  uint32_t ADCValue = 0;
uint16_t ADC_RX2_BUF[ADC_MAX_RECV_LEN];
void delayMS(uint32_t n)
{
		g_ticks = n;
		while(g_ticks);
}

int main()
{
	uint32_t msCnt; 	// count value of 1ms
	uint32_t i,j;
    
//-----------------------------------------------------------------------
// Systick setting 
//-----------------------------------------------------------------------
	g_ticks = 1000; 	// 1000ms
	SystemCoreClockUpdate();
	msCnt = SystemCoreClock / 1000;
	SysTick_Config(msCnt); 

	ADC_Software_Trigger_Mode();

	DMATRG->DMATGS |= 1<<1;
	DMATRG->TGSEN0 = 1<< 5; 
	DMA_ADC_Config(DMA_VECTOR_ADC,DMA_Mode_Normal, (void *)&ADC->DATA[5],ADC_RX2_BUF,ADC_MAX_RECV_LEN);  
	DMA->DMAEN0 |= 1<<1;
	DMA_EN0 = 0X02;
	while(1)
	{
		for(i=65535;i>0;i--)
			for(j=110;j>0;j--);
		if(!ADC_IS_BUSY())
		{	
			ADC_Go();
			while(ADC_IS_BUSY());
		}

	}
}

/***********************************************************************************************************************
* Function Name: SysTick Handler
* Description  : Decreament the g_ticks value
* Arguments    : None
* Return Value : None
***********************************************************************************************************************/
void SysTick_Handler(void)
{
	g_ticks--;
}


